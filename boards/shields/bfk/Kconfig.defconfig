## boards/shields/bfk/Kconfig.defconfig
```kconfig
if SHIELD_BFK_LEFT

config ZMK_KEYBOARD_NAME
  default "BFK"

config ZMK_SPLIT_ROLE_CENTRAL
    default y

endif

if SHIELD_BFK_LEFT || SHIELD_BFK_RIGHT

config ZMK_SPLIT
    default y

endif
```

## boards/shields/bfk/Kconfig.shield
```kconfig
config SHIELD_BFK_LEFT
  def_bool $(shields_list_contains, bfk_left)

config SHIELD_BFK_RIGHT
  def_bool $(shields_list_contains, bfk_right)
```
