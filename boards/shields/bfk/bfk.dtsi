/ {
  chosen {
    zmk,kscan = &default_kscan;
  };

  default_kscan: kscan {
    compatible = "zmk,kscan-gpio-direct";
    label = "default_kscan";
    wakeup-source;

    input-gpios =
      <&pro_micro  8 (GPIO_ACTIVE_LOW | GPIO_PULL_UP)>, // 1
      <&pro_micro  3 (GPIO_ACTIVE_LOW | GPIO_PULL_UP)>, // 2
      <&pro_micro  2 (GPIO_ACTIVE_LOW | GPIO_PULL_UP)>, // 3
      <&pro_micro  0 (GPIO_ACTIVE_LOW | GPIO_PULL_UP)>, // 4
      <&pro_micro  1 (GPIO_ACTIVE_LOW | GPIO_PULL_UP)>, // 5
      <&pro_micro  9 (GPIO_ACTIVE_LOW | GPIO_PULL_UP)>, // 6
      <&pro_micro  7 (GPIO_ACTIVE_LOW | GPIO_PULL_UP)>, // 7
      <&pro_micro  6 (GPIO_ACTIVE_LOW | GPIO_PULL_UP)>, // 8
      <&pro_micro  5 (GPIO_ACTIVE_LOW | GPIO_PULL_UP)>, // 9
      <&pro_micro  4 (GPIO_ACTIVE_LOW | GPIO_PULL_UP)>, // 10
      <&pro_micro 14 (GPIO_ACTIVE_LOW | GPIO_PULL_UP)>, // 11
      <&pro_micro 15 (GPIO_ACTIVE_LOW | GPIO_PULL_UP)>, // 12
      <&pro_micro 18 (GPIO_ACTIVE_LOW | GPIO_PULL_UP)>, // 13
      <&pro_micro 19 (GPIO_ACTIVE_LOW | GPIO_PULL_UP)>, // 14
      <&pro_micro 20 (GPIO_ACTIVE_LOW | GPIO_PULL_UP)>, // 15
      <&pro_micro 16 (GPIO_ACTIVE_LOW | GPIO_PULL_UP)>, // 16
      <&pro_micro 10 (GPIO_ACTIVE_LOW | GPIO_PULL_UP)>; // 17
  };
};
