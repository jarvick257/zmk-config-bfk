#include <behaviors.dtsi>
#include <dt-bindings/zmk/keys.h>
#include <dt-bindings/zmk/bt.h>


/ {
  keymap {
    compatible = "zmk,keymap";

    default_layer {
      bindings = <
        &kp KP_0,
        &kp KP_1,
        &kp KP_2,
        &kp KP_3,
        &kp KP_4,
        &kp KP_5,
        &kp KP_6,
        &kp KP_7,
        &kp KP_8,
        &kp KP_9,
        &kp KP_0,
        &kp KP_1,
        &kp KP_2,
        &kp KP_3,
        &kp KP_4,
        &kp KP_5,
        &kp KP_6,
      >;
    };
  };
};
